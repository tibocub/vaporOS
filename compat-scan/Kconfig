## motd/Kconfig
```kconfig
config VAPOROS_MOTD
	tristate "motd -- print the vaporOS logo"
	default n
	---help---
		Prints the ASCII logo. vinit runs it before the shell starts.
```

## portable_cat/Kconfig
```kconfig
config VAPOROS_PORTABLE_CAT
	tristate "portable_cat -- pure ISO C stdio portability test"
	default n
	---help---
		Prints file contents (or stdin) to stdout. Uses nothing beyond
		<stdio.h> -- not even getopt. A weaker portable-C tier than
		portable_wc, on purpose: this is testing what the plainest
		possible C program needs, not what's convenient to write.

if VAPOROS_PORTABLE_CAT

config VAPOROS_PORTABLE_CAT_PROGNAME
	string "Program name"
	default "vcat"

config VAPOROS_PORTABLE_CAT_PRIORITY
	int "priority"
	default 100

config VAPOROS_PORTABLE_CAT_STACKSIZE
	int "stack size"
	default DEFAULT_TASK_STACKSIZE

endif
```

## toybox/Kconfig
```kconfig
config VAPOROS_TOYBOX
	tristate "toybox -- vendored multicall, 13 applets so far (docs/vaporshell.md)"
	default n
	---help---
		Vendored toybox (codeberg.org/landley/toybox), patched for
		NuttX portability, built as a single multicall "tbx"
		program. vaporshell spawns it with argv[0] set to whichever
		applet name was typed (posix_spawnp("tbx", ..., argv)),
		the same way a real Unix symlink-based multicall install
		would work, just resolved by vaporshell's own table instead
		of the filesystem.

		Registered as "tbx". vaporshell/NuttX's own Application.mk
		renames this program's real entry point to <PROGNAME>_main
		-- and toybox's own main.c unconditionally calls an
		internal multiplexer function that ALSO needs to be named
		exactly "toybox_main" (wired to generated/newtoys.h's own
		hardcoded "toybox" table entry via macro token-pasting, not
		something a plain rename can dodge). Rather than fight that,
		this build's real entry point is vapor_entry.c, not
		toybox's own main.c -- it calls toybox's public toy_exec()
		directly instead of going through toybox's own main()/
		toybox_main() dispatcher at all, so PROGNAME never has to
		match anything toybox's own generated tables hardcode. Run
		applets as `tbx true`, `tbx echo hi`, etc.

		Batch 2: added cat, mkdir, rmdir, touch, printf, rm.
		Batch 3: added ls, cp, mv (mv_main lives in cp.c, no
		separate mv.c upstream). One real NuttX-specific gap found
		and fixed: cp's own cp_xattr() unconditionally calls
		xattr_get/set/list, which are genuinely absent on NuttX
		(same as lib/portability.c's own existing treatment) --
		only reachable via explicit --preserve=xattr/all, not plain
		-p/-a, so given an honest non-fatal warning instead of
		either erroring the whole copy or silently pretending it
		worked. Still not the full ~218-command set. See the
		Makefile in this directory for what expanding scope
		actually requires (mainly:
		regenerating generated/*.h on a host toybox checkout).

if VAPOROS_TOYBOX

config VAPOROS_TOYBOX_PROGNAME
	string "Program name"
	default "tbx"

config VAPOROS_TOYBOX_PRIORITY
	int "priority"
	default 100

config VAPOROS_TOYBOX_STACKSIZE
	int "stack size"
	default DEFAULT_TASK_STACKSIZE

endif
```

## vaporui/Kconfig
```kconfig
config VAPOROS_VAPORUI
	tristate "vaporUI examples (TUI library from ../vaporUI)"
	default n
	---help---
		Builds the vaporUI library (sibling checkout ../vaporUI, POSIX backend)
		with a few of its examples as commands: vui_windows, vui_textarea,
		vui_input, vui_colors, vui_buttons, vui_layout. Used to check
		vaporUI's RAM and flash use on small boards.

if VAPOROS_VAPORUI

config VAPOROS_VAPORUI_PRIORITY
	int "vaporUI examples priority"
	default 100

config VAPOROS_VAPORUI_STACKSIZE
	int "vaporUI examples stack size"
	default 4096

config VAPOROS_VAPORUI_TERMINAL
	bool "vaporUI terminal widget (vui_windows gets a Terminal window)"
	default n
	depends on PSEUDOTERM
	---help---
		Builds src/ext/terminal.c and the vendored libvterm, and runs a shell
		in a pty inside a vui_windows window. libvterm keeps ~40 bytes per
		cell (twice with the alternate screen): too much for small boards.

endif
```

## vbench/Kconfig
```kconfig
config VAPOROS_VBENCH
	tristate "vbench -- scripting-VM benchmark host (../langbench)"
	default n
	---help---
		Runs the langbench benchmark scripts (embedded in the image) in one
		scripting VM and prints time and heap use per benchmark. The VM is
		chosen below; one VM per image keeps flash and RAM numbers clean.
		The sources live in ../langbench (see its README), not in this repo.

if VAPOROS_VBENCH

choice
	prompt "VM under test"
	default VAPOROS_VBENCH_LUA

config VAPOROS_VBENCH_LUA
	bool "Lua 5.4 (NuttX's copy; do not enable INTERPRETERS_LUA too)"

config VAPOROS_VBENCH_WREN
	bool "Wren"

config VAPOROS_VBENCH_BERRY
	bool "Berry"

config VAPOROS_VBENCH_MQUICKJS
	bool "MicroQuickJS (own copy; do not enable INTERPRETERS_MQUICKJS too)"

config VAPOROS_VBENCH_JERRYSCRIPT
	bool "JerryScript (ES.next profile)"

config VAPOROS_VBENCH_MICROPYTHON
	bool "MicroPython (embed port)"

endchoice

config VAPOROS_VBENCH_JERRY_HEAP_KB
	int "JerryScript heap size (KB, fixed at build time)"
	default 80
	depends on VAPOROS_VBENCH_JERRYSCRIPT

config VAPOROS_VBENCH_STACKSIZE
	int "stack size"
	default 16384

config VAPOROS_VBENCH_PRIORITY
	int "priority"
	default 100

endif
```

## vhello/Kconfig
```kconfig
config VAPOROS_VHELLO
	tristate "vaporOS hello (proof that apps/external works)"
	default n
	---help---
		A minimal vaporOS command, to prove the apps/external
		mechanism reaches a custom, out-of-tree vaporOS app.

if VAPOROS_VHELLO

config VAPOROS_VHELLO_PROGNAME
	string "Program name"
	default "vhello"

config VAPOROS_VHELLO_PRIORITY
	int "vhello task priority"
	default 100

config VAPOROS_VHELLO_STACKSIZE
	int "vhello stack size"
	default DEFAULT_TASK_STACKSIZE

endif
```

## vinit/Kconfig
```kconfig
config VAPOROS_VINIT
	tristate "vinit -- vaporOS init: USB console + vaporshell, no NSH"
	default n
	---help---
		Boot entrypoint for boards without NSH (USB CDC/ACM or UART console).
		Brings up the CDC/ACM gadget, waits for a host to connect (three
		Enters, like NSH's own usbconsole), points stdio at it and runs
		vaporshell, restarting the wait when the host disconnects or the
		shell exits. Set CONFIG_INIT_ENTRYPOINT="vinit_main" to use it.

if VAPOROS_VINIT

config VAPOROS_VINIT_PROGNAME
	string "Program name"
	default "vinit"

config VAPOROS_VINIT_PRIORITY
	int "priority"
	default 100

config VAPOROS_VINIT_STACKSIZE
	int "stack size"
	default 2048

config VAPOROS_VINIT_SHELL
	string "Shell to run"
	default "vaporshell"

config VAPOROS_VINIT_CDCACM
	bool "Bring up the USB CDC/ACM gadget (USB console)"
	default y
	depends on CDCACM
	---help---
		Connect the CDC/ACM gadget through boardctl before opening the
		console. Turn off for a UART (or any console that needs no setup).

config VAPOROS_VINIT_WAIT_HOST
	bool "Wait for three Enters before starting the shell"
	default y
	---help---
		A USB console device node opens as soon as USB is up, long before a
		terminal program is attached; three Enters prove one is. A UART is
		always "attached", so turn this off there.

config VAPOROS_VINIT_TTY
	string "Console device"
	default "/dev/ttyACM0"
	---help---
		Device node of the console, e.g. /dev/ttyACM0, /dev/ttyS0 or
		/dev/console. Set by the board's console hardware descriptor
		(hardware/console/*.conf).

endif
```

## vlua/Kconfig
```kconfig
config VAPOROS_VLUA
	tristate "vlua -- vaporOS's own Lua API host (print/read basics)"
	depends on INTERPRETERS_LUA
	default n
	---help---
		A small program that creates its own Lua state and exposes a
		"vapor" table (vapor.print, vapor.read) to Lua scripts -- the
		first slice of the ComputerCraft-style high-level API. Reuses
		NuttX's own Lua interpreter sources (enable INTERPRETERS_LUA
		first), doesn't bundle a second copy of Lua.

if VAPOROS_VLUA

config VAPOROS_VLUA_PROGNAME
	string "Program name"
	default "vlua"

config VAPOROS_VLUA_LIBDIR
	string "System-wide Lua library directory"
	default "/usr/lib/lua"
	---help---
		Searched by require() after ./lua_modules (the project's own
		libraries) and before the current directory: LIBDIR/?.lua and
		LIBDIR/?/init.lua. Must be on a persistent filesystem on boards
		that have one (the RP2040 uses /flash/lib/lua). A LUA_PATH
		environment variable, if set, replaces all of this.

config VAPOROS_VLUA_HOSTLIBDIR
	string "Host directory to mount at the system library directory"
	default ""
	depends on FS_HOSTFS
	---help---
		For the simulator, which has no persistent filesystem of its
		own: if set and LIBDIR does not exist, vlua mounts this host
		directory (relative to where the simulator runs) there with
		hostfs. Leave empty on boards with real storage.

config VAPOROS_VLUA_LUA_ALIAS
	bool "Also register vlua as the command \"lua\""
	default n
	---help---
		Needs the stock NuttX lua command renamed (INTERPRETERS_LUA_PROGNAME),
		otherwise both claim the name "lua".

config VAPOROS_VLUA_PRIORITY
	int "priority"
	default 100

config VAPOROS_VLUA_STACKSIZE
	int "stack size"
	default DEFAULT_TASK_STACKSIZE

menu "Lua C libraries (sources live next to this repo, see setup.sh)"

config VAPOROS_VLUA_LFS
	bool "lfs -- LuaFileSystem (../luafilesystem)"
	default n
	---help---
		require("lfs"): attributes, dir, mkdir, rmdir, touch, setmode...
		lfs.symlinkattributes and lfs.lock_dir need symlinks/readlink, which
		most NuttX filesystems lack; they return nil, err there.

config VAPOROS_VLUA_LPEG
	bool "lpeg -- parsing expression grammars (../lpeg-1.1.0)"
	default n
	---help---
		require("lpeg"). Pure ANSI C. re.lua (lpeg's regex-like layer) is
		plain Lua, install it with the other pure-Lua libraries.

config VAPOROS_VLUA_LPEG_MAXRULES
	int "lpeg: maximum rules per grammar (MAXRULES)"
	depends on VAPOROS_VLUA_LPEG
	default 1000
	---help---
		lpeg's left-recursion check recurses once per rule step, up to this
		many levels, at about 40 bytes of C stack each on a Cortex-M0+. 1000
		(upstream) needs ~45 KB, more than a small vlua stack has, and a
		left-recursive grammar then overflows it and resets the board. Keep
		it below about (vlua stack size - 10 KB) / 45. Also the most rules
		a grammar may have.

config VAPOROS_VLUA_LPEG_MAXRECLEVEL
	int "lpeg: maximum capture nesting (MAXRECLEVEL)"
	depends on VAPOROS_VLUA_LPEG
	default 200
	---help---
		Collecting nested captures recurses once per level, and lpeg's
		pushcapture reserves a 572-byte frame (Cortex-M0+), so upstream's 200
		needs over 100 KB of stack and resets the board when a pattern nests
		captures that deep. Keep it below about (vlua stack size - 10 KB) / 700.

config VAPOROS_VLUA_CJSON
	bool "cjson -- JSON encode/decode (../lua-cjson)"
	default n
	---help---
		require("cjson"). About 8 KB of flash on the RP2040 (the bundled
		dtoa.c is not used; numbers go through libc snprintf/strtod).
		Like upstream, every decoded number is a Lua float.

config VAPOROS_VLUA_SOCKET
	bool "vsock -- TCP client sockets (vlua/vsock.c)"
	depends on NET_TCP
	default n
	---help---
		require("vsock"): connect/send/recv/close with timeouts. The primitives
		under vpm's HTTP client; about 1 KB of code. Needs the network stack.

config VAPOROS_VLUA_ED25519
	bool "vsign -- ed25519 signature verification (../Monocypher)"
	default n
	---help---
		require("vsign"): vsign.verify(signature, message, public_key). Checks the
		signed package index in vpm, so an index fetched over plain HTTP can be
		trusted. Verification only (signing is done by the publisher). Small:
		Monocypher is one portable C file, compiled with sections that the linker drops.

config VAPOROS_VLUA_TLS
	bool "vtls -- TLS client connections (mbedTLS, vlua/vtls.c)"
	depends on VAPOROS_VLUA_SOCKET
	select CRYPTO_MBEDTLS
	default n
	---help---
		require("vtls"): an HTTPS-capable connection with the same interface as
		vsock. Certificates and host names are always verified against a PEM
		bundle the caller names. Large: mbedTLS adds a few hundred KB of flash
		and a handshake needs tens of KB of heap, so it is not for the smallest
		boards.

endmenu

endif
```

## vterm/Kconfig
```kconfig
config VAPOROS_VTERMTEST
	tristate "vtermtest -- libvterm Milestone 1: build+parse smoke test"
	default n
	---help---
		Vendored libvterm (MIT, Paul Evans) compiled through the real
		NuttX app pipeline, plus a small test that feeds it a string
		containing real ANSI escape sequences and prints back what it
		parsed. Milestone 1 of docs/vaporterm.md -- proves the library
		itself is portable here before any NX rendering work is built
		on top of it.

if VAPOROS_VTERMTEST

config VAPOROS_VTERMTEST_PROGNAME
	string "Program name"
	default "vtermtest"

config VAPOROS_VTERMTEST_PRIORITY
	int "priority"
	default 100

config VAPOROS_VTERMTEST_STACKSIZE
	int "stack size"
	default DEFAULT_TASK_STACKSIZE

endif
```

## vterm_fb/Kconfig
```kconfig
config VAPOROS_VTERM_FB
	tristate "vterm_fb -- Milestone 3: real NSH rendered via libvterm"
	depends on NXFONTS
	depends on NSH_LIBRARY
	default n
	---help---
		A real NSH session (nsh_consolemain) with its stdout/stderr
		redirected to our own /dev/vaporterm0 character device, whose
		write callback feeds libvterm and drives the same nxfonts
		glyph rendering Milestone 2 proved works -- no NX window or
		compositor involved, following apps/examples/fbcon's proven
		mechanics for talking to /dev/fb0 directly. Milestone 3 of
		docs/vaporterm.md. Keyboard input still comes from this
		process's own stdin (the host terminal on sim), not from
		clicking into the window -- that's later work. Needs a
		framebuffer device (CONFIG_SIM_X11FB on sim), an enabled NX
		font (CONFIG_NXFONT_X11_MISC_FIXED_10X20), and NSH_LIBRARY.

if VAPOROS_VTERM_FB

config VAPOROS_VTERM_FB_PROGNAME
	string "Program name"
	default "vterm_fb"

config VAPOROS_VTERM_FB_PRIORITY
	int "priority"
	default 100

config VAPOROS_VTERM_FB_STACKSIZE
	int "stack size"
	default DEFAULT_TASK_STACKSIZE

endif
```
