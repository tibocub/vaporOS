## vlr/Kconfig
```kconfig
config VAPOROS_VLR
	tristate "vlr -- the portable Lua runtime (../vlr)"
	depends on !INTERPRETERS_LUA
	default n
	---help---
		The vlr runtime: its own patched Lua 5.4.8 (5.1-compatible dialect by default), the vapor
		API and event scheduler, built from the sibling checkout ../vlr with the shared source list
		vlr/sources.mk. Brings its own Lua, so it cannot be enabled together with NuttX's
		INTERPRETERS_LUA (duplicate symbols); boards pick one (features/vlr.conf or lua.conf).

if VAPOROS_VLR

config VAPOROS_VLR_PROGNAME
	string "Program name"
	default "vlr"

config VAPOROS_VLR_PRIORITY
	int "priority"
	default 100

config VAPOROS_VLR_STACKSIZE
	int "stack size"
	default DEFAULT_TASK_STACKSIZE

config VAPOROS_VLR_MAXCCALLS
	int "Lua: maximum nested C calls (LUAI_MAXCCALLS)"
	default 200
	---help---
		Each level costs stack (about 480 bytes on a Cortex-M0+, ~4 KB on the x86-64 simulator). Keep it
		below about (stack size - 10 KB) / cost per level. See docs/lua-runtime.md.

config VAPOROS_VLR_STRIP_INTERNAL
	bool "Strip debug info from vlr's own Lua code (saves ~3.4 KB of heap)"
	default y
	---help---
		The scheduler and compat layer are Lua sources compiled at startup and kept in RAM. Stripping drops
		their line info and local names: about 3.4 KB of the ~17 KB they cost (host measurement). Errors raised
		inside the scheduler then show no line numbers.

config VAPOROS_VLR_GC_PAUSE
	int "Lua GC pause (percent)"
	default 100
	---help---
		How much the heap may grow past the live data before a collection starts (Lua's default is 200 = double).
		100 collects as soon as garbage equals live data: needed for lfs's own test suite to fit on the RP2040.
		See VLR_GC_PAUSE in ../vlr/src/vlr.c.

config VAPOROS_VLR_GC_STEPMUL
	int "Lua GC step multiplier (percent)"
	default 400
	---help---
		How much collection work per allocation (Lua's default is 100). 400 with pause 100 costs CPU for RAM:
		on the RP2040 the string-building benchmark goes from 0.8 s to 4.8 s, the others are unchanged.

menu "Native modules (sources next to this repo, listed in ../vlr/modules.conf)"

config VAPOROS_VLR_FS
	bool "vapor.fs -- list, stat, mkdir, rmdir"
	default y

config VAPOROS_VLR_INPUT
	bool "vapor.input -- key, mouse and resize events (with the terminal decoder)"
	default y

config VAPOROS_VLR_NET
	bool "vapor.net -- TCP/UDP sockets and streams"
	depends on NET
	default n
	---help---
		Needs a NuttX network stack (CONFIG_NET with sockets). The RP2040 images have none yet; the sim needs usrsock or a
		network device. Name resolution blocks the whole task while it runs.

config VAPOROS_VLR_TLS
	bool "vapor.tls -- TLS client (BearSSL, ../BearSSL), certificate and host name always verified"
	depends on VAPOROS_VLR_NET
	default n
	---help---
		About 390 KB of code: for boards with a network and room (the sim), not for the RP2040. Needs a source of random numbers
		(/dev/urandom) and a PEM bundle of trusted roots (opts.cafile or $VLR_CA_FILE).

config VAPOROS_VLR_HTTP
	bool "std.http -- HTTP/1.1 client (pure Lua)"
	depends on VAPOROS_VLR_NET
	default n

config VAPOROS_VLR_SIGN
	bool "vapor.sign -- ed25519 signature verification (../Monocypher), for vpm's signed index"
	default n

config VAPOROS_VLR_REPL
	bool "vapor.repl -- the interactive prompt (vlr with no script, or vlr -i)"
	default y

config VAPOROS_VLR_LFS
	bool "lfs -- LuaFileSystem (../luafilesystem)"
	default n

config VAPOROS_VLR_LPEG
	bool "lpeg -- parsing expression grammars (../lpeg-1.1.0)"
	default n

config VAPOROS_VLR_LPEG_MAXRULES
	int "lpeg: maximum rules per grammar (MAXRULES)"
	depends on VAPOROS_VLR_LPEG
	default 1000
	---help---
		See VAPOROS_VLUA_LPEG_MAXRULES: lpeg recurses this many levels, ~45 bytes each on a Cortex-M0+.

config VAPOROS_VLR_LPEG_MAXRECLEVEL
	int "lpeg: maximum capture nesting (MAXRECLEVEL)"
	depends on VAPOROS_VLR_LPEG
	default 200
	---help---
		See VAPOROS_VLUA_LPEG_MAXRECLEVEL: 572 bytes of stack per level on a Cortex-M0+.

config VAPOROS_VLR_CJSON
	bool "cjson -- JSON encode/decode (../lua-cjson)"
	default n

endmenu

endif
```
